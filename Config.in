## configs/raspberrypi4_64_custom_defconfig
```kconfig
BR2_aarch64=y
BR2_cortex_a72=y
BR2_ARM_FPU_VFPV4=y
BR2_TOOLCHAIN_EXTERNAL=y
BR2_PER_PACKAGE_DIRECTORIES=y
BR2_TARGET_GENERIC_HOSTNAME="rpi-br"
BR2_TARGET_GENERIC_ISSUE=""
BR2_TARGET_GENERIC_PASSWD_SHA512=y
BR2_SYSTEM_BIN_SH_DASH=y
BR2_SYSTEM_DHCP="eth0"
BR2_TARGET_TZ_INFO=y
BR2_TARGET_TZ_ZONELIST="europe"
BR2_TARGET_LOCALTIME="Europe/Warsaw"
BR2_ROOTFS_POST_BUILD_SCRIPT="board/raspberrypi4-64/post-build.sh"
BR2_ROOTFS_POST_IMAGE_SCRIPT="$(BR2_EXTERNAL_RPI_PATH)/board/raspberrypi/post-image.sh"
BR2_LINUX_KERNEL=y
BR2_LINUX_KERNEL_CUSTOM_TARBALL=y
BR2_LINUX_KERNEL_CUSTOM_TARBALL_LOCATION="$(call github,rosowskimik,linux-rpi,cee7137b8814778a2178d65664bc3cb66f821104)/linux-cee7137b8814778a2178d65664bc3cb66f821104.tar.gz"
BR2_LINUX_KERNEL_USE_CUSTOM_CONFIG=y
BR2_LINUX_KERNEL_CUSTOM_CONFIG_FILE="$(BR2_EXTERNAL_RPI_PATH)/board/raspberrypi/linux_defconfig"
BR2_LINUX_KERNEL_IMAGEGZ=y
BR2_LINUX_KERNEL_DTS_SUPPORT=y
BR2_LINUX_KERNEL_INTREE_DTS_NAME="broadcom/bcm2711-rpi-4-b"
BR2_LINUX_KERNEL_NEEDS_HOST_OPENSSL=y
BR2_PACKAGE_LINUX_TOOLS_GPIO=y
BR2_PACKAGE_BUSYBOX_SHOW_OTHERS=y
BR2_PACKAGE_BZIP2=y
BR2_PACKAGE_GZIP=y
BR2_PACKAGE_XZ=y
BR2_PACKAGE_GREP=y
BR2_PACKAGE_JQ=y
BR2_PACKAGE_SED=y
BR2_PACKAGE_RPI_FIRMWARE=y
BR2_PACKAGE_RPI_FIRMWARE_VARIANT_PI4=y
BR2_PACKAGE_RPI_FIRMWARE_VARIANT_PI4_X=y
BR2_PACKAGE_RPI_FIRMWARE_CONFIG_FILE="$(BR2_EXTERNAL_RPI_PATH)/board/raspberrypi/config.txt"
BR2_PACKAGE_LZ4=y
BR2_PACKAGE_LZ4_PROGS=y
BR2_PACKAGE_ZLIB_NG=y
BR2_PACKAGE_CA_CERTIFICATES=y
BR2_PACKAGE_LIBCURL=y
BR2_PACKAGE_LIBCURL_CURL=y
BR2_PACKAGE_LIBCURL_WEBSOCKETS_SUPPORT=y
BR2_PACKAGE_IPUTILS=y
# BR2_PACKAGE_IPUTILS_ARPING is not set
# BR2_PACKAGE_IPUTILS_CLOCKDIFF is not set
# BR2_PACKAGE_IPUTILS_TRACEPATH is not set
BR2_PACKAGE_NTP=y
BR2_PACKAGE_OPENSSH=y
# BR2_PACKAGE_OPENSSH_CLIENT is not set
BR2_PACKAGE_RSYNC=y
BR2_PACKAGE_SUDO=y
BR2_PACKAGE_WHICH=y
BR2_PACKAGE_KMOD=y
BR2_PACKAGE_KMOD_TOOLS=y
BR2_PACKAGE_MONIT=y
BR2_PACKAGE_PROCPS_NG=y
BR2_PACKAGE_RSYSLOG=y
BR2_PACKAGE_START_STOP_DAEMON=y
BR2_PACKAGE_UTIL_LINUX=y
BR2_PACKAGE_UTIL_LINUX_KILL=y
BR2_PACKAGE_UTIL_LINUX_LOGGER=y
BR2_PACKAGE_UTIL_LINUX_MOUNT=y
BR2_PACKAGE_UTIL_LINUX_NOLOGIN=y
BR2_PACKAGE_VIM=y
BR2_TARGET_ROOTFS_EXT2=y
BR2_TARGET_ROOTFS_EXT2_4=y
BR2_TARGET_ROOTFS_EXT2_SIZE="600M"
# BR2_TARGET_ROOTFS_TAR is not set
BR2_PACKAGE_HOST_DOSFSTOOLS=y
BR2_PACKAGE_HOST_GENIMAGE=y
BR2_PACKAGE_HOST_KMOD_XZ=y
BR2_PACKAGE_HOST_MTOOLS=y
```

## package/card_reader/Config.in
```kconfig
config BR2_PACKAGE_CARD_READER
        bool "card_reader"
        help
          Card Reader App

if BR2_PACKAGE_CARD_READER

config BR2_PACKAGE_CARD_READER_INIT_LOCKED
        bool "Init locked"
        help
          Initial state for the lock that's set during startup

config BR2_PACKAGE_CARD_READER_SYSTEM_ID
        string "System ID"
        help
          Id used for communication with API

config BR2_PACKAGE_CARD_READER_INTERFACE
        string "Network interface"
        default "eth0"
        help
          Interface name to use for identification

config BR2_PACKAGE_CARD_READER_HOSTNAME
        string "API hostname"
        default "localhost"
        help
          API hostname to connect to

config BR2_PACKAGE_CARD_READER_RED_LED
        string "Red LED name"
        default "red:user"
        help
          Sysfs LED entry name for red led

config BR2_PACKAGE_CARD_READER_GREEN_LED
        string "Green LED name"
        default "green:user"
        help
          Sysfs LED entry name for green led

config BR2_PACKAGE_CARD_READER_STRENGTH
        int "Antenna strength"
        range 1 7
        default 5
        help
          Antenna strength to use for RFID receiver

config BR2_PACKAGE_CARD_READER_CARD_TIMEOUT
        string "Card reader timeout"
        default "5s"
        help
          How long should the app ignore card reader events
          after rejecting a card

config BR2_PACKAGE_CARD_READER_MOVEMENT_TIMEOUT
        string "Movement sensor timeout"
        default "20s"
        help
          How long the app should wait for no movement
          before triggering another movement event

endif
```
